## Kconfig
```kconfig
mainmenu "White Rabbit Switch  configuration"

config DOTCONF_FW_VERSION
	string "Firmware version"
	default "6.0.0"
	help
	  Free-text information about switch's firmware version. This field is
	  for information purpose only. Additionally this field describes
	  version of Kconfig.

config DOTCONF_HW_VERSION
	string "Hardware version"
	default "3.4"
	help
	  Free-text information about switch's Hardware version. This field is
	  for information purpose only.

config DOTCONF_INFO
	string "Additional info about dot-config"
	help
	  Free-text information about switch's dot-config. This field is
	  for information purpose only.

#
# Select source of dot-config file
# 

choice DOTCONF_SOURCE
	  prompt "Source for a run-time replacement of dot-config"
	  default DOTCONF_SOURCE_TRY_DHCP

config DOTCONF_SOURCE_LOCAL
	bool "Use local dot-config"
	help
	  The White Rabbit Switch is configured at run-time,
	  according to a dot-config .config file. The file
	  is the same .config you are defining now. If you
	  select this option, dot-config is not replaced
	  at run time.

config DOTCONF_SOURCE_REMOTE
	bool "Use remote dot-config"
	help
	  Use the URL to dot-config provided in DOTCONF_URL.

config DOTCONF_SOURCE_FORCE_DHCP
	bool "Force to get the URL to a dot-config via DHCP"
	depends on ETH0_DHCP
	help
	  Retrieve a URL to the dot-config via DHCP at boot.
	  The URL can be configured in the "filename" configuration field of
	  the DHCP server.

config DOTCONF_SOURCE_TRY_DHCP
	bool "Try to get the URL to a dot-config via DHCP"
	help
	  The same as DOTCONF_SOURCE_FORCE_DHCP, but this option does not
	  cause errors in SNMP's objects if the switch fails to retrieve
	  the URL to the dot-config via DHCP.

endchoice

config DOTCONF_URL
	string "URL for a run-time replacement of dot-config"
	depends on DOTCONF_SOURCE_REMOTE
	help
	  tftp://, ftp:// or http:// URLs are allowed. Names are allowed if
	  you configured a DNS server. The special strings HOSTNAME, IPADDR and
	  MACADDR are substituted before retrieving the file.
	  Example:  "tftp://morgana/wrs-config-IPADDR"

#
# Select source of leap seconds file
# 
choice LEAPSEC_SOURCE
	  prompt "Source for a run-time replacement of leap seconds file"
	  default LEAPSEC_SOURCE_LOCAL

config LEAPSEC_SOURCE_LOCAL
	bool "Use local leap seconds file"
	help
	  A leap seconds file (leap-seconds.list) is already present in the White Rabbit Switch.
	  If you select this option, the leap seconds file is not replaced
	  at run time.

config LEAPSEC_SOURCE_REMOTE_FORCE
	bool "Force remote leap seconds file"
	help
	  Use the URL to leap secondw file provided in LEAPSEC_URL.
	  If the file cannot be downloaded, it will cause errors in SNMP's objects.

config LEAPSEC_SOURCE_REMOTE_TRY
	bool "Try remote leap seconds file"
	help
	  The same as LEAPSEC_SOURCE_REMOTE_FORCE, but this option does not
	  cause errors in SNMP's objects if the switch fails to retrieve
	  the URL to the leap seconds files.
endchoice

config LEAPSEC_URL
	string "URL for a run-time replacement of leap seconds file"
	default "ftp://ftp.nist.gov/pub/time/leap-seconds.list"
	depends on LEAPSEC_SOURCE_REMOTE_TRY || LEAPSEC_SOURCE_REMOTE_FORCE
	help
	  tftp://, ftp:// or http:// URLs are allowed. Names are allowed if
	  you configured a DNS server. The special strings HOSTNAME, BOOTSERVER, IPADDR and
	  MACADDR are substituted before retrieving the file.
	  Example:  "tftp://BOOTSERVER/leap-seconds.IPADDR"


config BR2_CONFIGFILE
	string "Configuration file for Buildroot"
	default "wrs_release_br2_config"
	help
	  The configuration file selects which packages are to be
	  included in the WRS filesystem and which are not.  If
	  you pass a relative pathname, the build procedure will
	  look for it in wr-switch-sw/configs/buildroot, while
	  absolute pathnames are used unchanged.

	  If the string being passed doesn't refer to a file, the
	  scripts print a warning and use the default file. Incorrect
	  files lead to unpredicatable results.

config PPSI
	bool
	default y

menu "Local Network Configuration"

choice
	prompt "Management port configuration (eth0)"
	default ETH0_DHCP

config ETH0_DHCP
	bool "DHCP forever"
	help
	  Try DHCP on management port (eth0) forever.

config ETH0_DHCP_ONCE
	bool "Try DHCP, if fail use static address"
	help
	  Try DHCP on management port (eth0) for a while, then configure
	  static IP. Useful, when you move switch between various development
	  enviroments.

config ETH0_STATIC
	bool "Static address"
	help
	  Use static address on management port (eth0). Don't try to DHCP.

endchoice

menu "Management port (eth0) Address"
depends on ETH0_DHCP_ONCE || ETH0_STATIC

config ETH0_IP
	string "Static IP address of management port (eth0)"
	default "192.168.1.254"
	help
	  Static IP address of management port (eth0). Please note that
	  wrong IP address will generate a runtime error on the switch.

config ETH0_MASK
	string "Mask of management port (eth0)"
	default "255.255.255.0"
	help
	  Mask of management port (eth0). Please note that wrong mask will
	  generate a runtime error on the switch.

config ETH0_NETWORK
	string "Network of management port (eth0)"
	default "192.168.1.0"
	help
	  Network of management port (eth0). Please note that wrong network
	  will generate a runtime error on the switch.

config ETH0_BROADCAST
	string "Broadcast of management port (eth0)"
	default "192.168.1.255"
	help
	  Broadcast of management port (eth0). Please note that wrong broadcast
	  will generate a runtime error on the switch.

config ETH0_GATEWAY
	string "Default gateway of management port (eth0)"
	default "192.168.1.1"
	help
	  Default gateway of management port (eth0). Please note that
	  wrong gateway address will generate a runtime error on the switch.

endmenu

choice
	prompt "Hostname source"
	default HOSTNAME_DHCP

config HOSTNAME_DHCP
	bool "Get hostname via DHCP"
	help
	  Get hostname from DHCP server.

config HOSTNAME_STATIC
	bool "Use static hostname"
	help
	  Use static Hostname stored in CONFIG_HOSTNAME_STRING

endchoice

config HOSTNAME_STRING
	string "Static hostname of the switch"
	default "wrs"
	depends on HOSTNAME_STATIC
	help
	  Use this string as a static hostname of the switch.

menu "Authorization and authentication"

config ROOT_ACCESS_DISABLE
	bool "Disable root access via ssh"
	help
	  Used by ssh

config LDAP_ENABLE
	bool "Enable LDAP authorization"
	default false
	help
	  Enable LDAP authorization. Used by ssh.

config LDAP_SERVER
	string "LDAP server"
	depends on LDAP_ENABLE
	help
	  LDAP server(s) e.g. ldap://xldap.cern.ch

config LDAP_SEARCH_BASE
	string "LDAP search base"
	depends on LDAP_ENABLE
	help
	  LDAP search base e.g. dc=cern,dc=ch

choice
	prompt "LDAP filter"
	depends on LDAP_ENABLE
	default LDAP_FILTER_NONE

config LDAP_FILTER_NONE
	bool "Don't apply filter to LDAP"
	help
	  Allow all LDAP users to log in.

config LDAP_FILTER_EGROUP
	bool "Apply e-group filter to LDAP"
	help
	  Allow logins only from an e-group defined in CONFIG_LDAP_FILTER_EGROUP_STR
	  This option is CERN specific.

config LDAP_FILTER_CUSTOM
	bool "Apply custom filter to LDAP"
	help
	  Provide custom filtering string for LDAP authorization.

endchoice

config LDAP_FILTER_EGROUP_STR
	string "LDAP e-group"
 	depends on LDAP_FILTER_EGROUP
	help
	  LDAP's e-group for authorization. This option is CERN specific.

config LDAP_FILTER_CUSTOM_STR
	string "LDAP access filter string"
	depends on LDAP_FILTER_CUSTOM
	help
	  Custom string with a filter for LDAP authorization:
	  (memberOf=CN=white-rabbit-switch-root,OU=e-groups,OU=Workgroups,DC=cern,DC=ch)

choice
	prompt "Authorization method"
	depends on LDAP_ENABLE
	default AUTH_KRB5

config AUTH_LDAP
	bool "Enable LDAP authentication"
	depends on LDAP_ENABLE
	help
	  Used by ssh for authentication

config AUTH_KRB5
	bool "Enable Kerberos authentication"
	depends on LDAP_ENABLE
	help
	  Used by ssh for authentication

endchoice

config AUTH_KRB5_SERVER
	string "Kerberos server"
 	depends on AUTH_KRB5
	help
	  Server name of Kerberos. Usually it is in capital letters.
	  For CERN, please use CERN.CH

menu "Root Password"


config ROOT_PWD_IS_ENCRYPTED
	bool "Should this file include an encripted root password?"
	help
	  The root password, as set here, can be in clear text or
	  encrypted. If it is specified as clear text, it is encrypted and
	  stored in the switch at run time.  If it specified in pre-encrypted
	  form, the string will just be copied in place. A clear-text
	  password in dot-config is less safe against sniffers.

config ROOT_PWD_CLEAR
	string "The password to be used at run time"
	depends on !ROOT_PWD_IS_ENCRYPTED
	default ""
	help
	  The string to be encrypted at boot time by the switch itself,
	  to later use normal ssh authentication. The empty string is
	  allowed.

config ROOT_PWD_CYPHER
	string "The password to be used at run time"
	depends on ROOT_PWD_IS_ENCRYPTED
	help
	  The actual pre-encrypted string. This is stored at run time
	  into /etc/passwd, for ssh authentication. To create the
	  string, please run "mkpasswd --method=md5 <password>"

endmenu

endmenu # "Authorization and authentication"

config NTP_SERVER
	string "IP address of local NTP server (empty for none)"
	help
	  At boot time, the White Rabbit time is primed by querying
	  an NTP server, if any is there.  Please write here the
	  IPV4 address (e.g.: "192.168.16.1"); an empty string
	  disables NTP-based priming.

config DNS_SERVER
	string "static IP address of local DNS server (empty for none)"
	help
	  Using names instead of IP addresses is sometimes handy. This
	  option allow to specify a static server name, that is stored
	  in /etc/resolv.conf, within the WRS image being built. If
	  the string is empty, /etc/resolv.conf is managed according
	  to buildroot defaults.

config DNS_DOMAIN
	string "Default domain for DNS resolution"
	help
	  If CONFIG_DNS_SERVER is being used, this option may be
	  useful as well.

config LOCAL_SYSLOG_FILE
	string "Store WRS syslog messages locally "
	default "/tmp/syslog"
	help
	  Select file to which syslog messages will be stored. 
	  The file is rotated when reaching 1MB. If remote
	  server is specified, the messages go to both, server and local file.

config REMOTE_SYSLOG_SERVER
	string "Send WRS syslog messages to this remote host"
	help
	  This IP address or name, if not empty enables remote syslog
	  in the switch; all messages are sent to this specific host.

config REMOTE_SYSLOG_UDP
	bool "Use UDP for syslog messages"
	default y
	help
	  Select UDP to send system logs. If not set, TCP is used.

config WRS_LOG_HAL
	string "Logging directions for the WR hal"
	default "default_syslog"
	help
	  The string can be:
	  - a pathname (e.g. /dev/kmsg), or
	  - a <facility>.<level> specification like "daemon.debug", or
	  - "default_syslog", or 
	  - an empty string
	  An empty string is used to represent no logging (like /dev/null).
	  When the string is "default_syslog", messages are sent to syslog with
	  the <facility>.<level> inherited from the messages (if not specified
	  in the message, daemon.info is used by default).
	  When the string is "<facility>.<level>", all messages produced by
	  the WR HAL if  syslog is configured will be passed to the syslog at 
	  the same  <facility>.<level>, no matter of verbosity of a message.
	  Please note that unknown facility names will generate a runtime error
	  on the switch.

config WRS_LOG_LEVEL_HAL
	string "Logging verbosity level for the WR HAL"
	default ""
	help
	  Specify verbosity of WR HAL as a string or number. The following
	  levels are supported:
	  ALERT (1)
	  ERROR (3)
	  WARNING (4)
	  INFO (6)
	  DEBUG (7)
	  By leaving this item empty, HAL will use its default verbosity level
	  (INFO).
	  Please note that all messages produced by the WR HAL if syslog is
	  configured will be passed to the syslog at the same
	  <facility>.<level>, no matter of verbosity of a message.

config WRS_LOG_RTU
	string "Logging directions for the RTU daemon"
	default "default_syslog"
	help
	The string can be:
	  - a pathname (e.g. /dev/kmsg), or
	  - a <facility>.<level> specification like "daemon.debug", or
	  - "default_syslog", or 
	  - an empty string
	  An empty string is used to represent no logging (like /dev/null).
	  When the string is "default_syslog", messages are sent to syslog with
	  the <facility>.<level> inherited from the messages(if not specified
	  in the message, daemon.info is used by default).
	  When the string is "<facility>.<level>", all messages produced by
	  the RTU if  syslog is configured will be passed to the syslog at 
	  the same  <facility>.<level>, no matter of verbosity of a message.
	  Please note that unknown facility names will generate a runtime error
	  on the switch.

config WRS_LOG_LEVEL_RTU
	string "Logging verbosity level for the RTU daemon"
	default ""
	help
	  Specify verbosity of RTU daemon as a string or number. The following
	  levels are supported:
	  ALERT (1)
	  ERROR (3)
	  WARNING (4)
	  INFO (6)
	  DEBUG (7)
	  By leaving this item empty, RTU daemon will use its default verbosity
	  level (INFO).
	  Please note that all messages produced by RTU daemon if syslog is
	  configured will be passed to the syslog at the same
	  <facility>.<level>, no matter of verbosity of a message.

config WRS_LOG_PTP
	string "Logging directions for the PTP server (ppsi)"
	default "daemon.info"
	help
	  The string can be a pathname (e.g. /dev/kmsg) or a <facility>.<level>
	  spefification like "daemon.debug". An empty strings is used
	  to represent no logging (like /dev/null).  Please note that
	  unknown facility names will generate a runtime error on the switch.
	  Please note that all messages produced by PPSi if syslog is
	  configured will be passed to the syslog at the same
	  <facility>.<level>, no matter of verbosity of a message.

config WRS_LOG_LEVEL_PTP
	string "Logging verbosity level for the PTP server (ppsi)"
	default ""
	help
	  Specify verbosity of PPSi daemon as a string. This string will be
	  passed to the PPSI after "-d" parameter. Please refer to the PPSI's
	  documentation for more details.
	  By leaving this item empty, PPSi daemon will use its default
	  verbosity level.
	  Please note that all messages produced by PPSi if syslog is
	  configured will be passed to the syslog at the same
	  <facility>.<level>, no matter of verbosity of a message.

config WRS_LOG_SNMPD
	string "Logging directions for the SNMP daemon"
	default "Swd"
	help
	  The string can be a pathname (e.g. /dev/kmsg) or a valid snmpd log
	  option (without -L). "Swd" will forward messages with priority at
	  least warning to syslog with daemon as facility. To set level (i.e. 5)
	  use "S 5 daemon". For details please check "man snmpcmd". An empty
	  strings is used  to represent no logging (like /dev/null). Please
	  note that unknown facility names will generate a runtime error on the
	  switch. NOTE: It looks like Notice is not a default logging priority
	  as writen in manual.

config WRS_LOG_MONIT
	string "Logging directions for the monit"
	default "syslog"
	help
	  The string can be a pathname (e.g. /dev/kmsg) or a "syslog" string.
	  An empty strings is used  to represent no logging. If it is needed to
	  select facility and level please leave here empty string and change
	  /etc/monitrc file directly.
	  Please note that unknown facility names will generate a runtime error
	  on the switch.

config WRS_LOG_OTHER
	string "Logging directions for other programs"
	default "default_syslog"
	help
	  Redirect output from other programs.
	  In the current version following programs uses this option:
	  --wrs_watchdog
	  --wrs_auxclk
	  --wrs_custom_boot_script.sh
	  --vlan.sh
	  This collective entry is to avoid number of entries in dot-config.
	  The string can be:
	  - a pathname (e.g. /dev/kmsg), or
	  - a <facility>.<level> specification like "daemon.debug", or
	  - "default_syslog", or 
	  - an empty string
	  An empty string is used to represent no logging (like /dev/null).
	  When the string is "default_syslog", messages are sent to syslog with
	  the <facility>.<level> inherited from the messages (if not specified
	  in the message, daemon.info is used by default).
	  When the string is "<facility>.<level>", all messages produced by
	  the programs if  syslog is configured will be passed to the syslog at
	  the same  <facility>.<level>, no matter of verbosity of a message.
	  Please note that unknown facility names will generate a runtime error
	  on the switch.

config WRS_LOG_LEVEL_OTHER
	string "Logging verbosity level for other programs"
	default ""
	help
	  Specify verbosity of other programs as a string or number. The
	  following levels are supported:
	  ALERT (1)
	  ERROR (3)
	  WARNING (4)
	  INFO (6)
	  DEBUG (7)
	  By leaving this item empty, other programs daemon will use their
	  default verbosity level (INFO).
	  Please note that all messages produced by other programs if syslog is
	  configured will be passed to the syslog at the same
	  <facility>.<level>

config KEEP_ROOTFS
	bool "Keep generated filesystem and related script"
	help
	  During development of build scripts, it may be useful
	  to keep the generated root filesystem as well as the
	  script used to create it. If selected, the build script
	  will report the actual file names at each build.
	  If unsusre, say N.

endmenu

source Kconfig_port_timing.in

source Kconfig_sfp_fiber.in

choice
	prompt "Timing Mode"
	default TIME_BC

config TIME_GM
	bool "Grand-Master"
	help
	  This options selects the White Rabbit Switch as a grandmaster,
	  i.e. it uses its input channels to track an Atomic or GPS and
	  claim to be a PTP authoritative source on the network.
	  The clockClass is set to 6 which designates a clock that is
	  synchronized to a primary reference time source.

config TIME_ARB_GM
	bool "Arbitrary Grand-Master"
	help
	  This options selects the White Rabbit Switch as a grandmaster,
	  i.e. it uses its input channels to track an application-specific 
	  source of time.
	  The clockClass is set to 13 which designates a clock that is
	  synchronized to an application-specific source of time. The timescale
	  distributed is then ARB (arbitrary).

config TIME_FM
	bool "Free-Running Master"
	help
	  The White Rabbit Switch pretends to be a master on his PTP
	  network, but it doesn't sync to an external source. Its own
	  internal clocks and counters are used to drive timing.
	  The clockClass is set to 193 and all ports must be set to
	  master-only mode.


config TIME_BC
	bool "Boundary Clock"
	help
	  The White Rabbit Switch is a normal PTP Boundary Clock: it is
	  slave on one of its ports and master on the other ones, according
	  to the standard Best Master Clock algorithm.
	  The clockClass is set to 248 which is the default clockClass.

config TIME_CUSTOM
	bool "Custom"
	help
	  This custom mode allows free access to the clock quality parameters.

endchoice

menu "PTP options"

config PTP_OPT_DOMAIN_NUMBER
	int "domain-number"
	default 0
	range 0 255
	help
	  A domain consists of one or more PTP devices communicating with each
	  other as defined by the PTP protocol. A domain defines the scope of
	  PTP message communication, state, operations, data sets, and
	  timescale. PTP devices may participate in multiple domains.
	  For more details please refer to the IEEE 1588-2008 standard.

config PTP_OPT_PRIORITY1
	int "priority1"
	default "128"
	range 0 255
	help
	  A user configurable designation that a clock belongs to an ordered
	  set of PTP devices from which a PTP Master is selected.
	  For more details please refer to the IEEE 1588-2008 standard

config PTP_OPT_PRIORITY2
	int "priority2"
	default "128"
	range 0 255
	help
	  A user configurable designation that provides finer grained ordering
	  among otherwise equivalent PTP devices.
	  For more details please refer to the IEEE 1588-2008 standard

config PTP_OPT_CLOCK_CLASS
	int "clock-class"
	default 6 if TIME_GM
	range 6 6 if TIME_GM
	default 13 if TIME_ARB_GM
	range 13 13 if TIME_ARB_GM
	default 193 if TIME_FM
	range 193 193 if TIME_FM
	default 248 if TIME_BC
	range 248 248 if TIME_BC
	default 248 if TIME_CUSTOM
	range 1 255 if TIME_CUSTOM 
	help
	  An attribute defining the TAI traceability, synchronization state and
	  expected performance of the time or frequency distributed by a
	  Boundary Clock or Ordinary Clock.
	  For more details please refer to the IEEE 1588-2008 standard.

config PTP_OPT_OVERWRITE_ATTRIBUTES
	boolean "Overwrite default PTP device attributes"
	depends on ! TIME_CUSTOM
	default FALSE
	help
	  This option allows to overwrite the default value depending 
	  of the timing mode for the clock accuracy, the clock Allan variance.

if PTP_OPT_OVERWRITE_ATTRIBUTES || TIME_CUSTOM

config PTP_OPT_CLOCK_ACCURACY
	int "clock-accuracy"
	default 33  if TIME_GM || TIME_ARB_GM 
	default 32  if TIME_FM
	default 254
	range 0 255
	help
	  An attribute defining the accuracy of the Local Clock (e.g. local
	  oscillator) of a Boundary Clock or Ordinary Clock.
	  For more details please refer to the IEEE 1588-2008 standard.

config PTP_OPT_CLOCK_ALLAN_VARIANCE
	int "clock-allan-variance/offsetScaledLogVariance"
	default 47360 if TIME_GM || TIME_ARB_GM 
	default 50973 if TIME_FM
	default 65535
	range 0 65535
	help
	  An attribute defining the stability of the Local Clock of a
	  Boundary Clock or Ordinary Clock.
	  For more details please refer to the IEEE 1588-2008 standard.
  
config PTP_OPT_TIME_SOURCE
	int "time-source"
	depends on ! TIME_BC 
	default 32 if TIME_GM || TIME_ARB_GM 
	default 160 if TIME_FM
	default 160
	range 0 255
	help
	  This information-only attribute indicates the source of time used
	  by the grandmaster (or free-running master).
	  
endif

endmenu #"PPSI options"

menu "PPS generation"
	
config PPSGEN_PTP_FALLBACK
	bool "PTP fallback"
	default N
	help
	  This option enables the PPS generation if a slave instance 
	  programmed to use an extension protocol (WR, L1Sync, ...) is falling back
	  to PTP communication only. 
	
config PPSGEN_PTP_THRESHOLD_MS
	int "PTP threshold (ms)"
	default 500
	range 1 1000
	help
	  This option defines the threshold corresponding to the offset from the 
	  master used to start the generation of the PPS. It is  either used by a PTP slave 
	  instance or a instance using a protocol extension but going into the fallback PTP mode 
	  and with the PTP fallback option active. 
	  A 0 value means that the PPS will be not generated for the considered cases. 
	  When the PPS is generated, it can be also disabled when the offset from master becomes greater
	  than the threshold value + 20%
	
config PPSGEN_GM_DELAY_TO_GEN_PPS_SEC
	int "Grand Master delay for PPS (sec)"
	default 0
	range 0 1000
	help
		This option allows a boundary/ordinary clock to generate PPS when it becomes Grand Master (GM) by BMCA. Becoming GM
		by BMCA might be a transitory situation during a network discovery. The PPS must be activated only when all this 
		transitory phase is terminated. This option then allows to define a delay in seconds to respect before 
		generating the PPS when a GM by BMCA is detected.  
		A 0 value desactivate this feature.
		
config PPSGEN_FORCE
	bool "Force PPS for testing purpose"
	default N
	help
	  This option enables the PPS generation for all cases. It should only be used for testing purpose. 

endmenu

choice
	prompt "PTP Port Assignment"
	default PTP_PORT_PARAMS
	help
	  You can choose either to use parameters defined in PORTxx_INSTxx or
	  your own custom configuration file placed in switch file system
	  or downloaded at boot time.

config PTP_PORT_PARAMS
	bool "Generate ppsi.conf based on the PORTxx_INSTyy_z parameters"
	help
	  Generate ppsi.conf based on "PORTxx_INSTyy_z parameters" and "role" specified for each
	  port.
	  PPSI's global settings can be set in file /wr/etc/ppsi-pre.conf

config PTP_CUSTOM
	bool "Custom ppsi.conf in the WRS file system"
	help
	  Use custom file for ppsi defined by CONFIG_PTP_CUSTOM_FILENAME.

config PTP_REMOTE_CONF
	bool "Download ppsi.conf from the network at each boot"
	help
	  This choice allows to specify an URL so you can download a
	  custom file using the network. This allows running a bunch
	  of switches, all with the same configuration but different
	  configurations that can't just be derived from PORT_PARAMS above.

endchoice

config PTP_CUSTOM_FILENAME
	string "Pathname for your custom ppsi.conf"
	depends on PTP_CUSTOM
	default "/wr/etc/ppsi-custom.conf"
	help
	  This is the filename used as ppsi.conf. Please note that the
	  file is copied to /etc/ppsi.conf when configuration is applied,
	  and the PTP daemon always picks /etc/ppsi.conf, not this
	  filename.

config PTP_CONF_URL
	depends on PTP_REMOTE_CONF
	string "Download URL (http, ftp, tftp) for custom ppsi.conf"
	help
	  Like CONFIG_DOTCONF_URL, this option allows passing HOSTNAME, IPADDR
	  and MACADDR in the filename, and if a DNS server is configured,
	  you can use host names.
	  For example: tftp://morgana/wrs-IPADDR-ppsi.conf


menu "Management configuration"
config SNMP_TRAPSINK_ADDRESS
	string "Static IP address or name where to send SNMPv1 traps"
	help
	  If not empty, the address or name is ussed as "trapsink"
	  destination in the SNMP configuration file for the switch.
	  It empty, no v1 traps are generated. If both this and
	  the following TRAP2SINK_ADDRESS are set, snmpd sends two
	  traps (one per protocol version). Trapcommunity is "public"
	  (not configurable so far).

config SNMP_TRAP2SINK_ADDRESS
	string "Static IP address or name where to send SNMPv2c traps"
	help
	  If not empty, the address or name is ussed as "trap2sink"
	  destination in the SNMP configuration file for the switch.
	  It empty, no v2c traps are generated. Trapcommunity is "public"
	  (not configurable so far).

config SNMP_RO_COMMUNITY
	string "Read-only community name for SNMP V1/V2 management"
	default "public"
	help
	  If not empty, the 'community' name is a sort of password,
	  that travels as clear text (we don't support encrypted SNMPv3
	  yet). The default is good for testing, but should be changed
	  for production. Please note, however, that the switch processes
	  SNMP only on the CPU Ethernet port (the copper "management" port).

config SNMP_RW_COMMUNITY
	string "Read-write community name for SNMP V1/V2 management"
	default "private"
	help
	  If not empty, the 'community' name is a sort of password,
	  that travels as clear text (we don't support encrypted SNMPv3
	  yet). The default is good for testing, but should be changed
	  for production. Please note, however, that the switch processes
	  SNMP only on the CPU Ethernet port (the copper "management" port).

config SNMP_TEMP_THOLD_FPGA
	int "Threshold level for FPGA temperature"
	default "80"
	help
	  Threshold level for FPGA temperature, when exceeded warning is
	  notified by SNMP via WR-SWITCH-MIB::wrsTemperatureWarning
	  Require hal restart after change

config SNMP_TEMP_THOLD_PLL
	int "Threshold level for PLL temperature"
	default "80"
	help
	  Threshold level for PLL temperature, when exceeded warning is
	  notified by SNMP via WR-SWITCH-MIB::wrsTemperatureWarning
	  Require hal restart after change

config SNMP_TEMP_THOLD_PSL
	int "Threshold level for Power Supply Left (PSL) temperature"
	default "80"
	help
	  Threshold level for Power Supply Left (PSL) temperature, when
	  exceeded warning is notified by SNMP via
	  WR-SWITCH-MIB::wrsTemperatureWarning
	  Require hal restart after change

config SNMP_TEMP_THOLD_PSR
	int "Threshold level for Power Supply Right (PSR) temperature"
	default "80"
	help
	  Threshold level for Power Supply Right (PSR) temperature, when
	  exceeded warning is notified by SNMP via
	  WR-SWITCH-MIB::wrsTemperatureWarning
	  Require hal restart after change

config SNMP_SWCORESTATUS_DISABLE
	bool "Force SNMP object wrsSwcoreStatus to be always OK"
	default false
	help
	  Disable checking SNMP object wrsSwcoreStatus"

# config items below are not implemented in the SNMP
#config SNMP_SWCORESTATUS_HP_FRAME_RATE
#	int "Maximum allowed rate of HP frames on a port"
#	depends on !SNMP_SWCORESTATUS_DISABLE
#	default "0"
#	help
#	  Error via SNMP if rate of HP frames on any port exceed given value.
#
#config SNMP_SWCORESTATUS_RX_FRAME_RATE
#	int "Maximum allowed rate of RX frames on a port"
#	depends on !SNMP_SWCORESTATUS_DISABLE
#	default "0"
#	help
#	  Error via SNMP if rate of RX frames on any port exceed given value.
#
#config SNMP_SWCORESTATUS_RX_PRIO_FRAME_RATE
#	int "Maximum allowed rate of any RX priority"
#	depends on !SNMP_SWCORESTATUS_DISABLE
#	default "0"
#	help
#	  Error if frame rate of any RX priority exceed given value.
#

menu "System clock monitor"

config SNMP_SYSTEM_CLOCK_MONITOR_ENABLED
	depends on  NTP_SERVER != ""
	bool "Enable system clock monitor"
	default y
	help
		When set, the local system time is compared to the time 
		returned by the NTP server (CONFIG_NTP_SERVER). If the difference
		of time exceed a given threshold (CONFIG_SNMP_SYSTEM_CLOCK_DRIFT_THOLD)
		then an error will be notified to SNMP.

config SNMP_SYSTEM_CLOCK_DRIFT_THOLD
	depends on SNMP_SYSTEM_CLOCK_MONITOR_ENABLED
	int "Threshold level for local system clock drift (seconds)"
	range 1 65535
	default 3
	help
	  Threshold level for the local system clock drift compared to 
	  a NTP server. The value is expressed in seconds.
	  When the threshold exceed, warning is notified by SNMP.

choice SNMP_SYSTEM_CLOCK_CHECK_INTERVAL_UNIT
	prompt "Unit of check interval value"
	depends on SNMP_SYSTEM_CLOCK_MONITOR_ENABLED
	default SNMP_SYSTEM_CLOCK_CHECK_INTERVAL_MINUTES
	help
	  Defines the unit used for the check interval value.

config SNMP_SYSTEM_CLOCK_UNIT_MINUTES
	bool "Minutes"

config SNMP_SYSTEM_CLOCK_UNIT_HOURS
	bool "Hours"

config SNMP_SYSTEM_CLOCK_UNIT_DAYS
	bool "Days	"	
	
endchoice

config SNMP_SYSTEM_CLOCK_CHECK_INTERVAL_MINUTES
	depends on SNMP_SYSTEM_CLOCK_MONITOR_ENABLED && SNMP_SYSTEM_CLOCK_UNIT_MINUTES
	int "Interval to verify system clock (Minutes)"
	range 1 59
	default 10
	help
	  Sets the time interval between checks of the system clock. 
	  This interval is expressed in minutes.

config SNMP_SYSTEM_CLOCK_CHECK_INTERVAL_HOURS
	depends on SNMP_SYSTEM_CLOCK_MONITOR_ENABLED && SNMP_SYSTEM_CLOCK_UNIT_HOURS
	int "Interval to verify system clock (Hours)"
	range 1 23
	default 1
	help
	  Sets the time interval between checks of the system clock.
	  This interval is expressed in hours.

config SNMP_SYSTEM_CLOCK_CHECK_INTERVAL_DAYS
	depends on SNMP_SYSTEM_CLOCK_MONITOR_ENABLED && SNMP_SYSTEM_CLOCK_UNIT_DAYS
	int "Interval to verify system clock (Days)"
	range 1 31 
	default 1
	help
	  Sets the time interval between checks of the system clock.
	  This interval is expressed in days

endmenu

endmenu

menu "External clk2 clock signal configuration"
config WRSAUXCLK_FREQ
	string "Frequency of the generated clock signal in MHz"
	default "10"
	help
	  --freq parameter of wrs_auxclk
	  Desired frequency of the generated clock signal in MHz. Available
	  range from 4kHz to 250MHz.

config WRSAUXCLK_DUTY
	string "Duty cycle of the generated clock signal"
	default "0.5"
	help
	  --duty parameter of wrs_auxclk
	  Desired duty cycle given as a fraction (e.g. 0.5, 0.4).

config WRSAUXCLK_CSHIFT
	string "Coarse shift of the generated clock signal"
	default "30"
	help
	  --cshift parameter of wrs_auxclk
	  Coarse shift (granularity 2ns) of the generated clock signal. This
	  parameter can be used to get desired delay relation between generated
	  1-PPS and clk2. The delay between 1-PPS and clk2 is constant for
	  a given bitstream but may be different for various hardware versions
	  and re-synthesized gateware. Therefore it should be measured and
	  adjusted only once for given hardware and gateware version.


config WRSAUXCLK_SIGDEL
	string "Signal delay of the generated clock signal"
	default "0"
	help
	  --sigdel parameter of wrs_auxclk
	  Clock signal generated from the FPGA is cleaned by a discrete
	  flip-flop. It may happen that generated aux clock is in phase with
	  the flip-flop clock. In that case it is visible on the oscilloscope
	  that clk2 clock is jittering by 4ns. The "Signal delay" parameter
	  allows to add a precise delay to the FPGA-generated clock to avoid
	  such jitter. This delay is specified in steps, where each step is
	  around 150ps. This value, same as the "Coarse shift" parameter, is
	  constant for a given bitstream so should be verified only once.


config WRSAUXCLK_PPSHIFT
	string "Fine signal delay of the generated clock signal"
	default "0"
	help
	  --ppshift parameter of wrs_auxclk
	  If one needs to precisely align 1-PPS output with the clk2 aux clock
	  using "Coarse shift" parameter is not enough as it has
	  4ns granularity. In that case this parameter lets you shift 1-PPS
	  output by a configured number of 150ps steps. However, please have in
	  mind that 1-PPS output is used as a reference for WR calibration
	  procedure. Therefore, once this parameter is modified, the device
	  should be re-calibrated. Otherwise, 1-PPS output will be shifted
	  from the WR timescale by <steps>*150ps.

endmenu

menu "NIC throttling configuration"
config NIC_THROTTLING_ENABLED
	bool "Enable NIC throttling"
	default n
	help
	  Limit the Rx bandwidth of the traffic that goes from WR ports to
	  Linux. Throttling can be enabled to prevent Linux using 100% of the
	  processing power to receive Ethernet frames coming from WR ports to
	  the CPU.

config NIC_THROTTLING_VAL
	int "NIC throttling value"
	depends on NIC_THROTTLING_ENABLED
	default "4000"
	range 1 65535
	help
	  Value to which bandwith should be limited (in KB/s).

endmenu

config PPS_IN_TERM_50OHM
	bool "Enable 50ohm termination for 1-PPS input"
	default n
	help
	  Enable 50ohm termination for 1-PPS input.

menu "Custom boot script configuration"
config CUSTOM_BOOT_SCRIPT_ENABLED
	bool "Execute custom script"
	default n
	help
	  Enable execution of a custom script during boot. It can be a local
	  script placed at /wr/bin/custom_boot_script.sh or downloaded from
	  a given URL. This script can be used for some exotic configurations
	  that dot-config does not support. This scipt runs before switching
	  is enabled.

choice CUSTOM_BOOT_SCRIPT_SOURCE
	prompt "Source for a custom boot script"
	depends on CUSTOM_BOOT_SCRIPT_ENABLED
	default CUSTOM_BOOT_SCRIPT_SOURCE_LOCAL
	help
	  Defines the source of a custom boot script. Local or remote.

config CUSTOM_BOOT_SCRIPT_SOURCE_LOCAL
	bool "Use local custom script"
	help
	  Use /wr/bin/custom_boot_script.sh to be executed at boot.

config CUSTOM_BOOT_SCRIPT_SOURCE_REMOTE
	bool "Use remote custom script"
	help
	  Use the URL in CUSTOM_BOOT_SCRIPT_SOURCE_REMOTE_URL to download the
	  custom boot script.

endchoice
config CUSTOM_BOOT_SCRIPT_SOURCE_REMOTE_URL
	string "URL of a custom script"
	depends on CUSTOM_BOOT_SCRIPT_SOURCE_REMOTE
	help
	  URL to the custom script. HOSTNAME, IPADDR and MACADDR are
	  substituted before retrieving the file.

	  Example:  "tftp://morgana/custom-script-IPADDR"

endmenu

menu "LLDP options"
config LLDPD_DISABLE
	bool "Disable LLDP daemon"
	default n
	help
	  Disable LLDP daemon to prevent sending LLDP frames. It may be useful
	  for networks not using LLDP or with a low latency requirement.

config LLDPD_TX_INTERVAL
	int "LLDP TX interval"
	default 5
	depends on !LLDPD_DISABLE
	help
	  Define how often LLDP frames are sent.

config LLDPD_MANAGEMENT_PORT_DISABLE
	bool "Disable LLDP on the management port"
	default n
	depends on !LLDPD_DISABLE
	help
	  Disable LLDP traffic on management port.

config LLDPD_MINIMUM_FRAME_SIZE
	bool "Send only minimum information via LLDP"
	default n
	depends on !LLDPD_DISABLE
	help
	  Send only minimum information via LLDP. May be useful in networks
	  which require low latency.
endmenu

config HTTPD_DISABLE
	bool "Disable web interface"
	default n
	help
	  Disable web interface.

menu "Developer options"
config MONIT_DISABLE
	bool "Disable monit"
	default n
	help
	  Disable monit to prevent processes' restarts. It may be useful for
	  development.

menu "Fan speed control"
config FAN_HYSTERESIS
	bool "Use hysteresis to control fan speed"
	default n
	help
	  Use hysteresis to control fans. Enable fans with PWM value
	  CONFIG_FAN_HYSTERESIS_PWM_VAL} when PLL's temperature exceeds
	  CONFIG_FAN_HYSTERESIS_T_ENABLE. Disable fans when temperature drops
	  below CONFIG_FAN_HYSTERESIS_T_DISABLE. These options are intended to
	  be used during development to reduce noise generated by a switch.
	  Don't use in production as this may affect the synchronization
	  performance.

config FAN_HYSTERESIS_T_DISABLE
	int "Disable fans temperature"
	default 60
	range 0 80
	depends on FAN_HYSTERESIS
	help
	  Temperature at which fans are disabled when working in hysteresis mode.

config FAN_HYSTERESIS_T_ENABLE
	int "Enable fans temperature"
	default 65
	range 0 80
	depends on FAN_HYSTERESIS
	help
	  Temperature at which fans are enabled when working in hysteresis mode.
	  Maximum allowed value is 80

config FAN_HYSTERESIS_PWM_VAL
	int "Value of fans' PWM"
	default 100
	range 4 1000
	depends on FAN_HYSTERESIS
	help
	  PWM value used to drive fans. Range from 4 to 1000.

endmenu # "Fan speed control"

config READ_SFP_DIAG_ENABLE
	bool "Read SFPs Diagnostic Monitoring"
	default n
	help
	  Let HAL to read Diagnostic Monitoring from SFP's eeprom.

choice
	prompt "Compilation optimization"
    
    config OPTIMIZATION_SPEED
        boolean "Execution time (-O2)"
        help
           GCC performs nearly all supported optimizations that do not involve a space-speed tradeoff.
           
     config OPTIMIZATION_SIZE_SPEED
        boolean "Size and execution time (-Os)"
        help
           Optimize for size. Enables all -O2 optimizations except those that often increase code size.
           
     config OPTIMIZATION_DEBUGGING
        boolean "Debugging (-Og)"
        help
           Should be the optimization level choice for the standard edit-compile-debug cycle

     config OPTIMIZATION_NONE_DEBUGGING
        boolean "Debugging without optimization(-ggdb)"
        help
           Compile without optimization and with debug informations 
endchoice

config OPTIMIZATION
	string
	default "-Os -ggdb" if OPTIMIZATION_SIZE_SPEED
	default "-O2 -ggdb" if OPTIMIZATION_SPEED
	default "-Og -ggdb" if OPTIMIZATION_DEBUGGING
	default "-ggdb" if OPTIMIZATION_NONE_DEBUGGING
	default "-ggdb"

endmenu # "Developer options"

menu "RTU HP mask"

config RTU_HP_MASK_ENABLE
	bool "Set custom High Priority mask in RTU"
	default n
	help
	  Set the mask which priorities are considered High Priority (this
	  only concerns the traffic which is fast-forwarded).


config RTU_HP_MASK_VAL
	string "HP mask"
	default 0
	depends on RTU_HP_MASK_ENABLE
	help
	  Mask with priorities (eg. 0x9 => priority 4 and 0 are considered HP)


endmenu

source Kconfig_vlans.in
```
